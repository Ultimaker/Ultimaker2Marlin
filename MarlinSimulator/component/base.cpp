#include <SDL/SDL.h>
#include "base.h"

#define DRAW_SCALE 3

extern SDL_Surface *screen;
std::vector<simBaseComponent*> simComponentList;

static const uint8_t lcd_font[] = {
    // font data
    0x00, 0x00, 0x00, 0x00, 0x00,// '\x00'
    0x00, 0x00, 0x00, 0x00, 0x00,// '\x01'
    0x00, 0x00, 0x00, 0x00, 0x00,// '\x02'
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	0x08, 0x1C, 0x2A, 0x08, 0x08 // <-
};

void drawString(const int x, const int y, const char* str, uint32_t color)
{
    int _x = x;
    while(*str)
    {
        drawChar(_x, y, *str, color);
        str++;
        _x += 6;
    }
}

void drawChar(const int x, const int y, const char c, uint32_t color)
{
    SDL_Rect rect;
    for(unsigned int n=0; n<5; n++)
    {
        int bits = lcd_font[c * 5 + n];
        for(unsigned int m=0; m<8; m++)
        {
            rect.x = x * DRAW_SCALE + n * DRAW_SCALE;
            rect.y = y * DRAW_SCALE + m * DRAW_SCALE;
            rect.w = DRAW_SCALE;
            rect.h = DRAW_SCALE;
            if (bits & (1L << m))
                SDL_FillRect(screen, &rect, color);
        }
    }
}

void drawStringSmall(const int x, const int y, const char* str, uint32_t color)
{
    int _x = x;
    while(*str)
    {
        drawCharSmall(_x, y, *str, color);
        str++;
        _x += 6 / DRAW_SCALE;
    }
}

void drawCharSmall(const int x, const int y, const char c, uint32_t color)
{
    SDL_Rect rect;
    for(unsigned int n=0; n<5; n++)
    {
        int bits = lcd_font[c * 5 + n];
        for(unsigned int m=0; m<8; m++)
        {
            rect.x = x * DRAW_SCALE + n;
            rect.y = y * DRAW_SCALE + m;
            rect.w = 1;
            rect.h = 1;
            if (bits & (1L << m))
                SDL_FillRect(screen, &rect, color);
        }
    }
}

void drawRect(const int x, const int y, const int w, const int h, uint32_t color)
{
    SDL_Rect rect = {x * DRAW_SCALE, y * DRAW_SCALE, w * DRAW_SCALE, h * DRAW_SCALE};
    if (rect.w == 0) rect.w = 1;
    if (rect.h == 0) rect.h = 1;
    SDL_FillRect(screen, &rect, color);
}
