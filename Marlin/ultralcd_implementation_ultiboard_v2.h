#ifndef ULTRA_LCD_IMPLEMENTATION_ULTIBOARD_V2_H
#define ULTRA_LCD_IMPLEMENTATION_ULTIBOARD_V2_H

/**
* Implementation of the LCD display routines for a SSD1309 OLED graphical display connected with i2c.
**/
#define LCD_GFX_WIDTH 128
#define LCD_GFX_HEIGHT 64

// All Ultipanels might have an encoder - so this is always be mapped onto first two bits
#define BLEN_C 2
#define BLEN_B 1
#define BLEN_A 0

#define EN_C (1<<BLEN_C)
#define EN_B (1<<BLEN_B) // The two encoder pins are connected through BTN_EN1 and BTN_EN2
#define EN_A (1<<BLEN_A)

#define LCD_CLICKED (buttons&EN_C)

/* Custom characters defined in the first 8 characters of the LCD */
//#define LCD_STR_BEDTEMP     "\x00"
//#define LCD_STR_DEGREE      "\x01"
//#define LCD_STR_THERMOMETER "\x02"
#define LCD_STR_UPLEVEL     "\x03"
#define LCD_STR_REFRESH     "\x04"
#define LCD_STR_FOLDER      "\x05"
//#define LCD_STR_FEEDRATE    "\x06"
//#define LCD_STR_CLOCK       "\x07"
#define LCD_STR_ARROW_RIGHT "\x7E"  /* from the default character set */

#define LED_ADDRESS 0b1100000

#define LCD_ADDRESS 0b0111100
#define LCD_WRITE   0x00
#define LCD_READ    0x01
#define LCD_SEND_COMMAND 0x00
#define LCD_SEND_DATA    0x40

#define LCD_COMMAND_CONTRAST                0x81
#define LCD_COMMAND_FULL_DISPLAY_ON_DISABLE 0xA4
#define LCD_COMMAND_FULL_DISPLAY_ON_ENABLE  0xA5
#define LCD_COMMAND_INVERT_DISABLE          0xA6
#define LCD_COMMAND_INVERT_ENABLE           0xA7
#define LCD_COMMAND_DISPLAY_OFF             0xAE
#define LCD_COMMAND_DISPLAY_ON              0xAF
#define LCD_COMMAND_NOP                     0xE3
#define LCD_COMMAND_LOCK_COMMANDS           0xDF

#define LCD_COMMAND_SET_ADDRESSING_MODE     0x20

#define LCD_RESET_PIN 5
#define LCD_CS_PIN    6

#define LCD_I2C_FREQ 200000

static const uint8_t lcd_font[] PROGMEM = {
    // font data
    0x00, 0x00, 0x00, 0x00, 0x00,// '\x00'
    0x06, 0x09, 0x09, 0x06, 0x00,// '\x01'
    0x60, 0x9E, 0x81, 0x9E, 0x60,// '\x02'
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	0x08, 0x1C, 0x2A, 0x08, 0x08 // <-
};

static const uint8_t large_number16[] PROGMEM = {
  /* page 0 (lines 0-7) */
  0x0,0xfc,0xfe,0x6,0x6,0x6,0x6,0xfe,0xfc,0x0,
  /* page 1 (lines 8-15) */
  0x0,0x3f,0x7f,0x60,0x60,0x60,0x60,0x7f,0x3f,0x0,
  /* page 2 (lines 16-23) */
  0x0,0x0,0x0,0x0,0xfe,0xfe,0x0,0x0,0x0,0x0,
  /* page 3 (lines 24-31) */
  0x0,0x0,0x0,0x0,0x7f,0x7f,0x0,0x0,0x0,0x0,
  /* page 4 (lines 32-39) */
  0x0,0x6,0x86,0x86,0x86,0x86,0x86,0xfe,0xfc,0x0,
  /* page 5 (lines 40-47) */
  0x0,0x3f,0x7f,0x61,0x61,0x61,0x61,0x61,0x60,0x0,
  /* page 6 (lines 48-55) */
  0x0,0x6,0x6,0x86,0x86,0x86,0x86,0xfe,0x7c,0x0,
  /* page 7 (lines 56-63) */
  0x0,0x60,0x60,0x61,0x61,0x61,0x61,0x7f,0x3f,0x0,
  /* page 8 (lines 64-71) */
  0x0,0x0,0x80,0xe0,0x78,0x1e,0xfe,0xfe,0x0,0x0,
  /* page 9 (lines 72-79) */
  0x0,0x6,0x7,0x7,0x6,0x6,0x7f,0x7f,0x6,0x0,
  /* page 10 (lines 80-87) */
  0x0,0xfc,0xfe,0x86,0x86,0x86,0x86,0x86,0x6,0x0,
  /* page 11 (lines 88-95) */
  0x0,0x60,0x61,0x61,0x61,0x61,0x61,0x7f,0x3f,0x0,
  /* page 12 (lines 96-103) */
  0x0,0xfc,0xfe,0x86,0x86,0x86,0x86,0x86,0x0,0x0,
  /* page 13 (lines 104-111) */
  0x0,0x3f,0x7f,0x61,0x61,0x61,0x61,0x7f,0x3f,0x0,
  /* page 14 (lines 112-119) */
  0x0,0x6,0x6,0x6,0x6,0x86,0xf6,0x7e,0xe,0x0,
  /* page 15 (lines 120-127) */
  0x0,0x0,0x0,0x60,0x7c,0x1f,0x3,0x0,0x0,0x0,
  /* page 16 (lines 128-135) */
  0x0,0x7c,0xfe,0x86,0x86,0x86,0x86,0xfe,0x7c,0x0,
  /* page 17 (lines 136-143) */
  0x0,0x3f,0x7f,0x61,0x61,0x61,0x61,0x7f,0x3f,0x0,
  /* page 18 (lines 144-151) */
  0x0,0xfc,0xfe,0x86,0x86,0x86,0x86,0xfe,0xfc,0x0,
  /* page 19 (lines 152-159) */
  0x0,0x0,0x61,0x61,0x61,0x61,0x61,0x7f,0x3f,0x0,
};
static const uint8_t large_number24[] PROGMEM = {
  0x0,0x0,0xf8,0xfc,0xfe,0xe,0xe,0xe,0xe,0xe,0xe,0xe,0xfe,0xfc,0xf8,0x0,
  0x0,0x0,0xff,0xff,0xff,0x0,0x0,0x0,0x0,0x0,0x0,0x0,0xff,0xff,0xff,0x0,
  0x0,0x0,0x1f,0x3f,0x7f,0x70,0x70,0x70,0x70,0x70,0x70,0x70,0x7f,0x3f,0x1f,0x0,
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  0x0,0x0,0x0,0x70,0x70,0x70,0x70,0x70,0x70,0x70,0x70,0x70,0x7f,0x3f,0x1f,0x0,
};

static uint8_t lcd_contrast = 0xDF;

static void lcd_implementation_init();
static inline void i2c_start();
static inline void i2c_send_raw(uint8_t data)
{
    TWDR = data;
    TWCR = (1<<TWINT) | (1<<TWEN);
//    MSerial.print('|');
    while (!(TWCR & (1<<TWINT))) {}
//    MSerial.println(int(TWSR), HEX);
/*    if ((TWSR & 0xF8) == 0x38)
    {
        WRITE(54, 0);
        while(1) {}
        //Arbitration lost. The atmel goes into slave mode...
//        TWCR = 0;
//        lcd_implementation_init();
//        i2c_start();
    }
*/
}

static inline void i2c_start_led()
{
    TWCR = (1<<TWINT)|(1<<TWSTA)|(1<<TWEN);
//    MSerial.print('=');
    while (!(TWCR & (1<<TWINT))) {}
//    MSerial.println(int(TWSR), HEX);
    i2c_send_raw(LED_ADDRESS << 1);
}

static inline void i2c_start()
{
    TWCR = (1<<TWINT)|(1<<TWSTA)|(1<<TWEN);
//    MSerial.print('=');
    while (!(TWCR & (1<<TWINT))) {}
//    MSerial.println(int(TWSR), HEX);
    i2c_send_raw(LCD_ADDRESS << 1 | LCD_WRITE);
}
static inline void i2c_start_data()
{
    i2c_start();
    i2c_send_raw(LCD_SEND_DATA);
}
static inline void i2c_start_command()
{
    i2c_start();
    i2c_send_raw(LCD_SEND_COMMAND);
}

static inline void i2c_end()
{
    TWCR = (1<<TWINT)|(1<<TWEN)|(1<<TWSTO);
//    MSerial.println('X');
}

static void led_write(uint8_t addr, uint8_t data)
{
    i2c_start_led();
    i2c_send_raw(addr);
    i2c_send_raw(data);
    i2c_end();
}

static void lcd_implementation_clear()
{
    i2c_start_data();
    for(uint16_t n=0;n<128*64/8;n++)
        i2c_send_raw(0);
    i2c_start_command();
    i2c_send_raw(LCD_COMMAND_CONTRAST);
    i2c_send_raw(0xDF);
    lcd_contrast = 0xDF;
    i2c_end();
}

static void lcd_implementation_init()
{
    SET_OUTPUT(LCD_CS_PIN);
    SET_OUTPUT(LCD_RESET_PIN);
    SET_OUTPUT(20);
    SET_OUTPUT(21);
    SET_OUTPUT(54);

    WRITE(54, 1);
    WRITE(LCD_CS_PIN, 0);
    WRITE(20, 1);
    WRITE(21, 1);

    WRITE(LCD_RESET_PIN, 0);
    _delay_ms(1);
    WRITE(LCD_RESET_PIN, 1);
    _delay_ms(100);

    SET_OUTPUT(15);
    WRITE(15, 0);

    //ClockFreq = (F_CPU) / (16 + 2*TWBR * 4^TWPS)
    //TWBR = ((F_CPU / ClockFreq) - 16)/2*4^TWPS
    TWBR = ((F_CPU / LCD_I2C_FREQ) - 16)/2*1;
    TWSR = 0x00;

    led_write(0, 0x80);//MODE1
    led_write(1, 0x1C);//MODE2
    led_write(2, 0x20);//PWM0
    led_write(3, 0x20);//PWM1
    led_write(4, 0x20);//PWM2
    led_write(5, 0x20);//PWM3
    led_write(6, 0xFF);//GRPPWM
    led_write(7, 0x00);//GRPFREQ
    led_write(8, 0xAA);//LEDOUT

    i2c_start_command();

    i2c_send_raw(LCD_COMMAND_LOCK_COMMANDS);
    i2c_send_raw(0x12);

    i2c_send_raw(LCD_COMMAND_DISPLAY_OFF);

    i2c_send_raw(0xD5);//Display clock divider/freq
    i2c_send_raw(0xA0);

    i2c_send_raw(0xA8);//Multiplex ratio
    i2c_send_raw(0x3F);

    i2c_send_raw(0xD3);//Display offset
    i2c_send_raw(0x00);

    i2c_send_raw(0x40);//Set start line

    i2c_send_raw(0xA1);//Segment remap

    i2c_send_raw(0xC8);//COM scan output direction
    i2c_send_raw(0xDA);//COM pins hardware configuration
    i2c_send_raw(0x12);

    i2c_send_raw(LCD_COMMAND_CONTRAST);
    i2c_send_raw(0xDF);

    i2c_send_raw(0xD9);//Pre charge period
    i2c_send_raw(0x82);

    i2c_send_raw(0xDB);//VCOMH Deslect level
    i2c_send_raw(0x34);

    i2c_send_raw(LCD_COMMAND_SET_ADDRESSING_MODE);

    i2c_send_raw(LCD_COMMAND_FULL_DISPLAY_ON_DISABLE);

    i2c_send_raw(LCD_COMMAND_DISPLAY_ON);

    i2c_end();
    lcd_implementation_clear();
}
static void lcd_draw_char(const char chr)
{
    const uint8_t* c = lcd_font + chr * 5;
    i2c_send_raw(pgm_read_byte(c++));
    i2c_send_raw(pgm_read_byte(c++));
    i2c_send_raw(pgm_read_byte(c++));
    i2c_send_raw(pgm_read_byte(c++));
    i2c_send_raw(pgm_read_byte(c++));
    i2c_send_raw(0x00);
}
static void lcd_draw_char_inverted(const char chr)
{
    const uint8_t* c = lcd_font + chr * 5;
    i2c_send_raw(pgm_read_byte(c++) ^ 0xFF);
    i2c_send_raw(pgm_read_byte(c++) ^ 0xFF);
    i2c_send_raw(pgm_read_byte(c++) ^ 0xFF);
    i2c_send_raw(pgm_read_byte(c++) ^ 0xFF);
    i2c_send_raw(pgm_read_byte(c++) ^ 0xFF);
    i2c_send_raw(0xFF);
}

static void lcd_draw_string(const char* str, uint8_t width)
{
    char c;
    while((c = *str++) != '\0' && width > 0)
    {
        lcd_draw_char(c);
        width--;
    }
    while(width)
    {
        lcd_draw_char(' ');
        width--;
    }
}

static uint8_t lcd_printPGM(const char* str)
{
    char c;
    uint8_t n = 0;
    while((c = pgm_read_byte(str++)) != '\0')
    {
        lcd_draw_char(c);
        n++;
    }
    return n;
}
static uint8_t lcd_printPGMinverted(const char* str)
{
    char c;
    uint8_t n = 0;
    while((c = pgm_read_byte(str++)) != '\0')
    {
        lcd_draw_char_inverted(c);
        n++;
    }
    return n;
}

static void lcd_set_pos(uint8_t col, uint8_t row)
{
    i2c_start_command();
    i2c_send_raw(0x00 | (col & 0x0F));
    i2c_send_raw(0x10 | (col >> 4));
    i2c_send_raw(0xB0 | row);
}

static void lcd_draw_large_number16(uint8_t col, uint8_t row, uint8_t nr)
{
    lcd_set_pos(col, row);
    i2c_start_data();
    const uint8_t* c = large_number16 + nr * 10 * 2;
    for(uint8_t n=0;n<10;n++)
        i2c_send_raw(pgm_read_byte(c++));

    lcd_set_pos(col, row + 1);
    i2c_start_data();
    for(uint8_t n=0;n<10;n++)
        i2c_send_raw(pgm_read_byte(c++));
}

static void lcd_draw_large_number24(uint8_t col, uint8_t row, uint8_t nr)
{
    lcd_set_pos(col, row);
    i2c_start_data();
    const uint8_t* c = large_number24 + nr * 16 * 3;
    for(uint8_t n=0;n<16;n++)
        i2c_send_raw(pgm_read_byte(c++));

    lcd_set_pos(col, row + 1);
    i2c_start_data();
    for(uint8_t n=0;n<16;n++)
        i2c_send_raw(pgm_read_byte(c++));

    lcd_set_pos(col, row + 2);
    i2c_start_data();
    for(uint8_t n=0;n<16;n++)
        i2c_send_raw(pgm_read_byte(c++));
}

static const uint8_t ultimaker_logo[] PROGMEM = {
  /* page 0 (lines 0-7) */
  0x0,0x0,0x0,0x0,0x0,0x0,0x0,0x0,0x0,0x0,0x0,0x0,0x0,0x0,0x0,0x0,
  0x0,0x0,0x0,0x0,0x0,0x0,0x0,0x0,0x0,0x0,0x0,0x0,0x0,0x0,0x0,0x0,
  0x0,0x0,0x0,0x0,0x0,0x0,0x0,0x0,0x0,0x0,0x0,0x0,0x0,0x0,0x0,0x0,
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  0x0,0x0,0x0,0x0,0x0,0x0,0x0,0x0,0x0,0x0,0x0,0x0,0x0,0x0,0x0,0x0,

  /* page 1 (lines 8-15) */
  0x0,0x0,0x0,0x0,0x0,0x0,0x0,0x0,0x0,0x0,0x0,0x0,0x0,0x0,0x0,0x0,
  0x0,0x0,0x0,0x0,0x0,0x0,0x0,0x0,0x0,0x0,0x0,0x0,0x0,0x0,0x0,0x0,
  0x0,0x0,0x0,0x0,0x0,0x0,0x0,0x0,0x0,0x0,0x0,0x0,0x0,0x0,0x0,0x0,
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  0x0,0x0,0x0,0x0,0x0,0x0,0x0,0x0,0x0,0x0,0x0,0x0,0x0,0x0,0x0,0x0,

  /* page 2 (lines 16-23) */
  0x0,0x0,0x0,0x0,0x0,0x0,0x0,0x0,0x0,0x0,0x0,0x0,0x0,0x0,0x0,0x0,
  0x0,0x0,0x0,0x0,0x0,0x0,0x0,0x0,0x0,0x0,0x0,0x0,0x0,0x0,0x0,0x0,
  0x0,0x0,0x0,0x0,0x0,0x0,0x0,0x0,0x0,0x0,0x0,0x0,0x0,0x0,0x0,0x0,
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  0x0,0x0,0x0,0x0,0x0,0x0,0x0,0x0,0x0,0x0,0x0,0x0,0x0,0x0,0x0,0x0,

  /* page 3 (lines 24-31) */
  0x0,0x0,0x0,0x0,0x0,0x0,0x3,0x3,0x3,0x3,0xff,0xff,0xff,0xfe,0x0,0x0,
  0x0,0x0,0x0,0x0,0xff,0xff,0xff,0xff,0x0,0x0,0x0,0x3,0xff,0xff,0xff,0x0,
  0x0,0x0,0x60,0xfc,0xfe,0xfe,0xfc,0x60,0x60,0x0,0x0,0x0,0xe7,0xff,0xe7,0x0,
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  0x20,0x70,0xf0,0xf0,0xe0,0xe0,0xf0,0xf0,0xf0,0x60,0x0,0x0,0x0,0x0,0x0,0x0,

  /* page 4 (lines 32-39) */
  0x0,0x0,0x0,0x0,0x0,0x0,0x0,0x0,0x0,0x0,0x3f,0xff,0xff,0xff,0xe0,0xc0,
  0xc0,0xc0,0xc0,0xe0,0xff,0xff,0xff,0xff,0x80,0x0,0x0,0x0,0xff,0xff,0xff,0x0,
  0x0,0x0,0x0,0xff,0xff,0xff,0xff,0x0,0x0,0x0,0x0,0x0,0xff,0xff,0xff,0x0,
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  0x0,0x0,0xff,0xff,0xff,0x1,0x0,0x0,0x0,0x0,0x0,0x0,0x0,0x0,0x0,0x0,

  /* page 5 (lines 40-47) */
  0x0,0x0,0x0,0x0,0x0,0x0,0x0,0x0,0x0,0x0,0x0,0x0,0x0,0x1,0x1,0x1,
  0x1,0x1,0x1,0x1,0x1,0x1,0x1,0x1,0x1,0x0,0x0,0x0,0x1,0x1,0x1,0x0,
  0x0,0x0,0x0,0x1,0x1,0x1,0x0,0x0,0x0,0x0,0x0,0x0,0x1,0x1,0x1,0x0,
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  0x0,0x0,0x1,0x1,0x1,0x0,0x0,0x0,0x0,0x0,0x0,0x0,0x0,0x0,0x0,0x0,

  /* page 6 (lines 48-55) */
  0x0,0x0,0x0,0x0,0x0,0x0,0x0,0x0,0x0,0x0,0x0,0x0,0x0,0x0,0x0,0x0,
  0x0,0x0,0x0,0x0,0x0,0x0,0x0,0x0,0x0,0x0,0x0,0x0,0x0,0x0,0x0,0x0,
  0x0,0x0,0x0,0x0,0x0,0x0,0x0,0x0,0x0,0x0,0x0,0x0,0x0,0x0,0x0,0x0,
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  0x0,0x0,0x0,0x0,0x0,0x0,0x0,0x0,0x0,0x0,0x0,0x0,0x0,0x0,0x0,0x0,

  /* page 7 (lines 56-63) */
  0x0,0x0,0x0,0x0,0x0,0x0,0x0,0x0,0x0,0x0,0x0,0x0,0x0,0x0,0x0,0x0,
  0x0,0x0,0x0,0x0,0x0,0x0,0x0,0x0,0x0,0x0,0x0,0x0,0x0,0x0,0x0,0x0,
  0x0,0x0,0x0,0x0,0x0,0x0,0x0,0x0,0x0,0x0,0x0,0x0,0x0,0x0,0x0,0x0,
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  0x0,0x0,0x0,0x0,0x0,0x0,0x0,0x0,0x0,0x0,0x0,0x0,0x0,0x0,0x0,0x0,
};

static uint8_t anim = LCD_GFX_HEIGHT - 20;
extern uint8_t lcd_status_update_delay;
extern uint8_t lcdDrawUpdate;
static void lcd_implementation_status_screen()
{
    i2c_start_command();
    if (anim > 0)
    {
        i2c_send_raw(0x00);
        i2c_send_raw(0x10);
        i2c_send_raw(0xB0);

        i2c_start_data();
        const uint8_t* ptr = ultimaker_logo;
        for(uint8_t m=0;m<LCD_GFX_HEIGHT / 8; m++)
        {
            for(uint8_t n=0;n<LCD_GFX_WIDTH;n++)
            {
                char c = pgm_read_byte(ptr++);
                if (m < anim / 8)
                    c = 0x00;
                if (m == anim / 8)
                    c = (c & (0xFF << (anim % 8)));
                i2c_send_raw(c);
            }
        }
        i2c_end();
        anim--;
        lcd_status_update_delay = 0;
        if (!anim)
            lcdDrawUpdate = 2;
        return;
    }

    if (lcd_contrast > 0x08)
        lcd_contrast -= 0x08;
    else
        lcd_contrast = 0;

    i2c_start_command();
    i2c_send_raw(LCD_COMMAND_CONTRAST);
    i2c_send_raw(lcd_contrast);

    int tHotend = int(degHotend(0) + 0.5);
    int tTarget = int(degTargetHotend(0) + 0.5);

    lcd_draw_large_number16( 0, 0, tHotend / 100);
    lcd_draw_large_number16(10, 0, (tHotend / 10) % 10);
    lcd_draw_large_number16(20, 0, (tHotend) % 10);
    lcd_draw_char('0' + tTarget / 100);
    lcd_draw_char('0' + tTarget / 10 % 10);
    lcd_draw_char('0' + tTarget % 10);

#if EXTRUDERS > 1
    tHotend = int(degHotend(1) + 0.5);
    tTarget = int(degTargetHotend(1) + 0.5);

    lcd_draw_large_number16(64+ 0, 0, tHotend / 100);
    lcd_draw_large_number16(64+10, 0, (tHotend / 10) % 10);
    lcd_draw_large_number16(64+20, 0, (tHotend) % 10);
    lcd_draw_char('0' + tTarget / 100);
    lcd_draw_char('0' + tTarget / 10 % 10);
    lcd_draw_char('0' + tTarget % 10);
#endif

#if TEMP_SENSOR_BED != 0
    tHotend = int(degBed() + 0.5);
    tTarget = int(degTargetBed() + 0.5);

    lcd_draw_large_number16( 0, 2, tHotend / 100);
    lcd_draw_large_number16(10, 2, (tHotend / 10) % 10);
    lcd_draw_large_number16(20, 2, (tHotend) % 10);
    lcd_draw_char('0' + tTarget / 100);
    lcd_draw_char('0' + tTarget / 10 % 10);
    lcd_draw_char('0' + tTarget % 10);
#endif

    lcd_draw_large_number16( 0, 4, feedmultiply / 100);
    lcd_draw_large_number16(10, 4, (feedmultiply / 10) % 10);
    lcd_draw_large_number16(20, 4, (feedmultiply) % 10);

    if (IS_SD_PRINTING)
    {
        uint8_t n = card.percentDone();
        lcd_draw_large_number24(64+ 0, 3, n / 100);
        lcd_draw_large_number24(64+16, 3, (n / 10) % 10);
        lcd_draw_large_number24(64+32, 3, n % 10);
    }

    lcd_set_pos(0, LCD_HEIGHT - 1);
    i2c_start_data();
    lcd_draw_string(lcd_status_message, LCD_WIDTH);
    i2c_end();
}

static void lcd_implementation_drawmenu_generic(uint8_t row, const char* pstr, char post_char)
{
    i2c_start_command();
    i2c_send_raw(0x00);
    i2c_send_raw(0x10);
    i2c_send_raw(0xB0 | row);

    i2c_start_data();
    i2c_send_raw(0x00);
    uint8_t n = LCD_WIDTH - 1 - lcd_printPGM(pstr);
    while(n--)
        lcd_draw_char(' ');
    lcd_draw_char(post_char);

    i2c_end();
}
static void lcd_implementation_drawmenu_generic_selected(uint8_t row, const char* pstr, char post_char)
{
    i2c_start_command();
    i2c_send_raw(0x00);
    i2c_send_raw(0x10);
    i2c_send_raw(0xB0 | row);

    i2c_start_data();
    i2c_send_raw(0xFF);
    uint8_t n = LCD_WIDTH - 1 - lcd_printPGMinverted(pstr);
    while(n--)
        lcd_draw_char_inverted(' ');
    lcd_draw_char_inverted(post_char);

    i2c_end();
}
static void lcd_implementation_drawmenu_setting_edit_generic(uint8_t row, const char* pstr, char* data)
{
    char c;
    uint8_t n = LCD_WIDTH - 1 - strlen(data);

    i2c_start_command();
    i2c_send_raw(0x00);
    i2c_send_raw(0x10);
    i2c_send_raw(0xB0 | row);

    i2c_start_data();
    i2c_send_raw(0x00);
    while((c = pgm_read_byte(pstr)) != '\0')
    {
        lcd_draw_char(c);
        pstr++;
        n--;
    }
    lcd_draw_char(':');
    while(n--)
        lcd_draw_char(' ');
    while((c = *data++))
        lcd_draw_char(c);
    i2c_end();
}
static void lcd_implementation_drawmenu_setting_edit_generic_selected(uint8_t row, const char* pstr, char* data)
{
    char c;
    uint8_t n = LCD_WIDTH - 1 - strlen(data);

    i2c_start_command();
    i2c_send_raw(0x00);
    i2c_send_raw(0x10);
    i2c_send_raw(0xB0 | row);

    i2c_start_data();
    i2c_send_raw(0xFF);
    while((c = pgm_read_byte(pstr)) != '\0')
    {
        lcd_draw_char_inverted(c);
        pstr++;
        n--;
    }
    lcd_draw_char_inverted(':');
    while(n--)
        lcd_draw_char_inverted(' ');
    while((c = *data++))
        lcd_draw_char_inverted(c);
    i2c_end();
}
static void lcd_implementation_drawmenu_setting_edit_generic_selected_P(uint8_t row, const char* pstr, const char* data)
{
    char c;
    uint8_t n = LCD_WIDTH - 1 - strlen_P(data);

    i2c_start_command();
    i2c_send_raw(0x00);
    i2c_send_raw(0x10);
    i2c_send_raw(0xB0 | row);

    i2c_start_data();
    i2c_send_raw(0xFF);
    while((c = pgm_read_byte(pstr)) != '\0')
    {
        lcd_draw_char_inverted(c);
        pstr++;
        n--;
    }
    lcd_draw_char_inverted(':');
    while(n--)
        lcd_draw_char_inverted(' ');
    while((c = pgm_read_byte(data++)))
        lcd_draw_char_inverted(c);
    i2c_end();
}
static void lcd_implementation_drawmenu_setting_edit_generic_P(uint8_t row, const char* pstr, const char* data)
{
    char c;
    uint8_t n = LCD_WIDTH - 1 - strlen_P(data);

    i2c_start_command();
    i2c_send_raw(0x00);
    i2c_send_raw(0x10);
    i2c_send_raw(0xB0 | row);

    i2c_start_data();
    i2c_send_raw(0x00);
    while((c = pgm_read_byte(pstr)) != '\0')
    {
        lcd_draw_char(c);
        pstr++;
        n--;
    }
    lcd_draw_char(':');
    while(n--)
        lcd_draw_char(' ');
    while((c = pgm_read_byte(data++)))
        lcd_draw_char(c);
    i2c_end();
}
#define lcd_implementation_drawmenu_setting_edit_byte_selected(row, pstr, pstr2, data, minValue, maxValue) lcd_implementation_drawmenu_setting_edit_generic_selected(row, pstr, itostr3(*(data)))
#define lcd_implementation_drawmenu_setting_edit_byte(row, pstr, pstr2, data, minValue, maxValue) lcd_implementation_drawmenu_setting_edit_generic(row, pstr, itostr3(*(data)))
#define lcd_implementation_drawmenu_setting_edit_int3_selected(row, pstr, pstr2, data, minValue, maxValue) lcd_implementation_drawmenu_setting_edit_generic_selected(row, pstr, itostr3(*(data)))
#define lcd_implementation_drawmenu_setting_edit_int3(row, pstr, pstr2, data, minValue, maxValue) lcd_implementation_drawmenu_setting_edit_generic(row, pstr, itostr3(*(data)))
#define lcd_implementation_drawmenu_setting_edit_int4_selected(row, pstr, pstr2, data, minValue, maxValue) lcd_implementation_drawmenu_setting_edit_generic_selected(row, pstr, itostr4(*(data)))
#define lcd_implementation_drawmenu_setting_edit_int4(row, pstr, pstr2, data, minValue, maxValue) lcd_implementation_drawmenu_setting_edit_generic(row, pstr, itostr4(*(data)))
#define lcd_implementation_drawmenu_setting_edit_float3_selected(row, pstr, pstr2, data, minValue, maxValue) lcd_implementation_drawmenu_setting_edit_generic_selected(row, pstr, ftostr3(*(data)))
#define lcd_implementation_drawmenu_setting_edit_float3(row, pstr, pstr2, data, minValue, maxValue) lcd_implementation_drawmenu_setting_edit_generic(row, pstr, ftostr3(*(data)))
#define lcd_implementation_drawmenu_setting_edit_float32_selected(row, pstr, pstr2, data, minValue, maxValue) lcd_implementation_drawmenu_setting_edit_generic_selected(row, pstr, ftostr32(*(data)))
#define lcd_implementation_drawmenu_setting_edit_float32(row, pstr, pstr2, data, minValue, maxValue) lcd_implementation_drawmenu_setting_edit_generic(row, pstr, ftostr32(*(data)))
#define lcd_implementation_drawmenu_setting_edit_float5_selected(row, pstr, pstr2, data, minValue, maxValue) lcd_implementation_drawmenu_setting_edit_generic_selected(row, pstr, ftostr5(*(data)))
#define lcd_implementation_drawmenu_setting_edit_float5(row, pstr, pstr2, data, minValue, maxValue) lcd_implementation_drawmenu_setting_edit_generic(row, pstr, ftostr5(*(data)))
#define lcd_implementation_drawmenu_setting_edit_float52_selected(row, pstr, pstr2, data, minValue, maxValue) lcd_implementation_drawmenu_setting_edit_generic_selected(row, pstr, ftostr52(*(data)))
#define lcd_implementation_drawmenu_setting_edit_float52(row, pstr, pstr2, data, minValue, maxValue) lcd_implementation_drawmenu_setting_edit_generic(row, pstr, ftostr52(*(data)))
#define lcd_implementation_drawmenu_setting_edit_float51_selected(row, pstr, pstr2, data, minValue, maxValue) lcd_implementation_drawmenu_setting_edit_generic_selected(row, pstr, ftostr51(*(data)))
#define lcd_implementation_drawmenu_setting_edit_float51(row, pstr, pstr2, data, minValue, maxValue) lcd_implementation_drawmenu_setting_edit_generic(row, pstr, ftostr51(*(data)))
#define lcd_implementation_drawmenu_setting_edit_long5_selected(row, pstr, pstr2, data, minValue, maxValue) lcd_implementation_drawmenu_setting_edit_generic_selected(row, pstr, ftostr5(*(data)))
#define lcd_implementation_drawmenu_setting_edit_long5(row, pstr, pstr2, data, minValue, maxValue) lcd_implementation_drawmenu_setting_edit_generic(row, pstr, ftostr5(*(data)))
#define lcd_implementation_drawmenu_setting_edit_bool_selected(row, pstr, pstr2, data) lcd_implementation_drawmenu_setting_edit_generic_selected_P(row, pstr, (*(data))?PSTR(MSG_ON):PSTR(MSG_OFF))
#define lcd_implementation_drawmenu_setting_edit_bool(row, pstr, pstr2, data) lcd_implementation_drawmenu_setting_edit_generic_P(row, pstr, (*(data))?PSTR(MSG_ON):PSTR(MSG_OFF))

#define lcd_implementation_drawmenu_setting_edit_callback_int3_selected(row, pstr, pstr2, data, minValue, maxValue, callback) lcd_implementation_drawmenu_setting_edit_generic_selected(row, pstr, itostr3(*(data)))
#define lcd_implementation_drawmenu_setting_edit_callback_int3(row, pstr, pstr2, data, minValue, maxValue, callback) lcd_implementation_drawmenu_setting_edit_generic(row, pstr, itostr3(*(data)))
#define lcd_implementation_drawmenu_setting_edit_callback_int4_selected(row, pstr, pstr2, data, minValue, maxValue, callback) lcd_implementation_drawmenu_setting_edit_generic_selected(row, pstr, itostr4(*(data)))
#define lcd_implementation_drawmenu_setting_edit_callback_int4(row, pstr, pstr2, data, minValue, maxValue, callback) lcd_implementation_drawmenu_setting_edit_generic(row, pstr, itostr4(*(data)))
#define lcd_implementation_drawmenu_setting_edit_callback_float3_selected(row, pstr, pstr2, data, minValue, maxValue, callback) lcd_implementation_drawmenu_setting_edit_generic_selected(row, pstr, ftostr3(*(data)))
#define lcd_implementation_drawmenu_setting_edit_callback_float3(row, pstr, pstr2, data, minValue, maxValue, callback) lcd_implementation_drawmenu_setting_edit_generic(row, pstr, ftostr3(*(data)))
#define lcd_implementation_drawmenu_setting_edit_callback_float32_selected(row, pstr, pstr2, data, minValue, maxValue, callback) lcd_implementation_drawmenu_setting_edit_generic_selected(row, pstr, ftostr32(*(data)))
#define lcd_implementation_drawmenu_setting_edit_callback_float32(row, pstr, pstr2, data, minValue, maxValue, callback) lcd_implementation_drawmenu_setting_edit_generic(row, pstr, ftostr32(*(data)))
#define lcd_implementation_drawmenu_setting_edit_callback_float5_selected(row, pstr, pstr2, data, minValue, maxValue, callback) lcd_implementation_drawmenu_setting_edit_generic_selected(row, pstr, ftostr5(*(data)))
#define lcd_implementation_drawmenu_setting_edit_callback_float5(row, pstr, pstr2, data, minValue, maxValue, callback) lcd_implementation_drawmenu_setting_edit_generic(row, pstr, ftostr5(*(data)))
#define lcd_implementation_drawmenu_setting_edit_callback_float52_selected(row, pstr, pstr2, data, minValue, maxValue, callback) lcd_implementation_drawmenu_setting_edit_generic_selected(row, pstr, ftostr52(*(data)))
#define lcd_implementation_drawmenu_setting_edit_callback_float52(row, pstr, pstr2, data, minValue, maxValue, callback) lcd_implementation_drawmenu_setting_edit_generic(row, pstr, ftostr52(*(data)))
#define lcd_implementation_drawmenu_setting_edit_callback_float51_selected(row, pstr, pstr2, data, minValue, maxValue, callback) lcd_implementation_drawmenu_setting_edit_generic_selected(row, pstr, ftostr51(*(data)))
#define lcd_implementation_drawmenu_setting_edit_callback_float51(row, pstr, pstr2, data, minValue, maxValue, callback) lcd_implementation_drawmenu_setting_edit_generic(row, pstr, ftostr51(*(data)))
#define lcd_implementation_drawmenu_setting_edit_callback_long5_selected(row, pstr, pstr2, data, minValue, maxValue, callback) lcd_implementation_drawmenu_setting_edit_generic_selected(row, pstr, ftostr5(*(data)))
#define lcd_implementation_drawmenu_setting_edit_callback_long5(row, pstr, pstr2, data, minValue, maxValue, callback) lcd_implementation_drawmenu_setting_edit_generic(row, pstr, ftostr5(*(data)))
#define lcd_implementation_drawmenu_setting_edit_callback_bool_selected(row, pstr, pstr2, data, callback) lcd_implementation_drawmenu_setting_edit_generic_selected_P(row, pstr, '>', (*(data))?PSTR(MSG_ON):PSTR(MSG_OFF))
#define lcd_implementation_drawmenu_setting_edit_callback_bool(row, pstr, pstr2, data, callback) lcd_implementation_drawmenu_setting_edit_generic_P(row, pstr, ' ', (*(data))?PSTR(MSG_ON):PSTR(MSG_OFF))

void lcd_implementation_drawedit(const char* pstr, char* value)
{
    char c;
    uint8_t n = LCD_WIDTH - 1 - 1 - strlen(value);

    i2c_start_command();
    i2c_send_raw(0x00);
    i2c_send_raw(0x10);
    i2c_send_raw(0xB0 | 2);

    i2c_start_data();
    i2c_send_raw(0x00);
    while((c = pgm_read_byte(pstr)) != '\0')
    {
        lcd_draw_char(c);
        pstr++;
        n--;
    }
    lcd_draw_char(':');
    while(n--)
        lcd_draw_char(' ');
    while((c = *value++))
        lcd_draw_char(c);
    i2c_end();
}
static void lcd_implementation_drawmenu_sdfile_selected(uint8_t row, const char* pstr, const char* filename, char* longFilename)
{
    (void)pstr;
    if (longFilename[0] != '\0')
    {
        filename = longFilename;
        longFilename[LCD_WIDTH] = '\0';
    }

    i2c_start_command();
    i2c_send_raw(0x00);
    i2c_send_raw(0x10);
    i2c_send_raw(0xB0 | row);

    i2c_start_data();
    i2c_send_raw(0xFF);
    uint8_t n = LCD_WIDTH;
    char c;
    while((c = *longFilename++))
    {
        lcd_draw_char_inverted(c);
        n--;
    }
    while(n--)
        lcd_draw_char_inverted(' ');
    i2c_end();
}
static void lcd_implementation_drawmenu_sdfile(uint8_t row, const char* pstr, const char* filename, char* longFilename)
{
    (void)pstr;
    if (longFilename[0] != '\0')
    {
        filename = longFilename;
        longFilename[LCD_WIDTH] = '\0';
    }

    i2c_start_command();
    i2c_send_raw(0x00);
    i2c_send_raw(0x10);
    i2c_send_raw(0xB0 | row);

    i2c_start_data();
    i2c_send_raw(0x00);
    uint8_t n = LCD_WIDTH;
    char c;
    while((c = *longFilename++))
    {
        lcd_draw_char(c);
        n--;
    }
    while(n--)
        lcd_draw_char(' ');
    i2c_end();
}
static void lcd_implementation_drawmenu_sddirectory_selected(uint8_t row, const char* pstr, const char* filename, char* longFilename)
{
    (void)pstr;
    if (longFilename[0] != '\0')
    {
        filename = longFilename;
        longFilename[LCD_WIDTH-1] = '\0';
    }

    i2c_start_command();
    i2c_send_raw(0x00);
    i2c_send_raw(0x10);
    i2c_send_raw(0xB0 | row);

    i2c_start_data();
    i2c_send_raw(0x00);
    lcd_draw_char_inverted(LCD_STR_FOLDER[0]);
    uint8_t n = LCD_WIDTH-1;
    char c;
    while((c = *longFilename++))
    {
        lcd_draw_char_inverted(c);
        n--;
    }
    while(n--)
        lcd_draw_char_inverted(' ');
    i2c_end();
}
static void lcd_implementation_drawmenu_sddirectory(uint8_t row, const char* pstr, const char* filename, char* longFilename)
{
    (void)pstr;
    if (longFilename[0] != '\0')
    {
        filename = longFilename;
        longFilename[LCD_WIDTH-1] = '\0';
    }

    i2c_start_command();
    i2c_send_raw(0x00);
    i2c_send_raw(0x10);
    i2c_send_raw(0xB0 | row);

    i2c_start_data();
    i2c_send_raw(0x00);
    lcd_draw_char(LCD_STR_FOLDER[0]);
    uint8_t n = LCD_WIDTH-1;
    char c;
    while((c = *longFilename++))
    {
        lcd_draw_char(c);
        n--;
    }
    while(n--)
        lcd_draw_char(' ');
    i2c_end();
}
#define lcd_implementation_drawmenu_back_selected(row, pstr, data) lcd_implementation_drawmenu_generic_selected(row, pstr, LCD_STR_UPLEVEL[0])
#define lcd_implementation_drawmenu_back(row, pstr, data) lcd_implementation_drawmenu_generic(row, pstr, LCD_STR_UPLEVEL[0])
#define lcd_implementation_drawmenu_submenu_selected(row, pstr, data) lcd_implementation_drawmenu_generic_selected(row, pstr, LCD_STR_ARROW_RIGHT[0])
#define lcd_implementation_drawmenu_submenu(row, pstr, data) lcd_implementation_drawmenu_generic(row, pstr, LCD_STR_ARROW_RIGHT[0])
#define lcd_implementation_drawmenu_gcode_selected(row, pstr, gcode) lcd_implementation_drawmenu_generic_selected(row, pstr, ' ')
#define lcd_implementation_drawmenu_gcode(row, pstr, gcode) lcd_implementation_drawmenu_generic(row, pstr, ' ')
#define lcd_implementation_drawmenu_function_selected(row, pstr, data) lcd_implementation_drawmenu_generic_selected(row, pstr, ' ')
#define lcd_implementation_drawmenu_function(row, pstr, data) lcd_implementation_drawmenu_generic(row, pstr, ' ')

static void lcd_implementation_draw_line(uint8_t row, const char* line)
{
    i2c_start_command();
    i2c_send_raw(0x00);
    i2c_send_raw(0x10);
    i2c_send_raw(0xB0 | row);

    i2c_start_data();
    lcd_printPGM(line);
    i2c_end();
}

static void lcd_implementation_draw_gfx_from_card(uint8_t itemNr, uint8_t totalItems)
{
    uint8_t sliderBarLength = ((LCD_GFX_HEIGHT-2) * uint16_t(itemNr + 1) / uint16_t(totalItems)) + 1;
    i2c_start_command();
    i2c_send_raw(0x00);
    i2c_send_raw(0x10);
    i2c_send_raw(0xB0);

    i2c_start_data();

    uint8_t screenCol = 0;
    uint8_t screenRow = 0;
    bool inComment = false;
    while(screenRow < LCD_GFX_HEIGHT/8)
    {
        char c = card.get();
        if (c == ';') inComment = true;
        if (c == '\n') inComment = false;
        //if (inComment)
        {
            if (screenCol < LCD_GFX_WIDTH - 4)
            {
                i2c_send_raw(c);
            }
            screenCol += 1;
            if (screenCol == LCD_GFX_WIDTH)
            {
                screenCol = 0;
                screenRow += 1;

                i2c_send_raw(0xFF);
                if (sliderBarLength < 8 * screenRow)
                {
                    if (screenRow == LCD_GFX_HEIGHT/8)
                    {
                        i2c_send_raw((0xFF >> ((8 * screenRow) - sliderBarLength))|0x80);
                        i2c_send_raw((0xFF >> ((8 * screenRow) - sliderBarLength))|0x80);
                    }else{
                        i2c_send_raw(0xFF >> ((8 * screenRow) - sliderBarLength));
                        i2c_send_raw(0xFF >> ((8 * screenRow) - sliderBarLength));
                    }
                }else{
                    i2c_send_raw(0xFF);
                    i2c_send_raw(0xFF);
                }
                i2c_send_raw(0xFF);
            }
        }
    }

    i2c_end();
}

#define _BEEP(c, n) for(int8_t _i=0;_i<c;_i++) { WRITE(BEEPER,HIGH); _delay_us(n); WRITE(BEEPER,LOW); _delay_us(n); }
static void lcd_implementation_quick_feedback()
{
    led_write(8, 0x55);//LEDOUT
#if BEEPER > -1
    SET_OUTPUT(BEEPER);
    _BEEP(20, 366);
    _BEEP(10, 150);
    //delay(100);
    /*
    for(int8_t i=0;i<30;i++)
    {
		WRITE(BEEPER,HIGH);
		_delay_us(150);
		WRITE(BEEPER,LOW);
		_delay_us(150);
    }*/
#endif
    led_write(8, 0xAA);//LEDOUT
}
#endif//ULTRA_LCD_IMPLEMENTATION_ULTIBOARD_V2_H
